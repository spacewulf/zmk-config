#include "cosmotyl.dtsi"
#include "68.h"

/ {
    bootloader_key: bootloader_key {
        compatible = "zmk,boot-magic-key";
        /* key-position = <48>; */
        key-position = <LF3>;
        jump-to-bootloader;
    };
};
