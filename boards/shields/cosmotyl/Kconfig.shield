## boards/shields/cosmotyl/Kconfig.shield
```kconfig
config SHIELD_cosmotyl_DONGLE
    def_bool $(shields_list_contains,cosmotyl_dongle)

config SHIELD_cosmotyl_LEFT
    def_bool $(shields_list_contains,cosmotyl_left)

config SHIELD_cosmotyl_RIGHT
    def_bool $(shields_list_contains,cosmotyl_right)
```

## boards/shields/spacemos/Kconfig.defconfig
```kconfig
if SHIELD_SPACEMOS_DONGLE

config ZMK_KEYBOARD_NAME
  default "spacemos"

config ZMK_SPLIT_ROLE_CENTRAL
  default y

config ZMK_SPLIT_BLE_CENTRAL_PERIPHERALS
  default 2

config BT_MAX_CONN
  default 7

config BT_MAX_PAIRED
  default 7

endif

if SHIELD_SPACEMOS_DONGLE || SHIELD_SPACEMOS_LEFT || SHIELD_SPACEMOS_RIGHT

config ZMK_SPLIT
  default y

endif

# if SHIELD_SPACEMOS_LEFT
#
# config ZMK_KEYBOARD_NAME
#   default "spacemos"
#
# config ZMK_SPLIT_ROLE_CENTRAL
#   default y
#
# endif
#
# if SHIELD_SPACEMOS_LEFT || SHIELD_SPACEMOS_RIGHT
#
# config ZMK_SPLIT
#   default y
#
# endif
```

## boards/shields/spacemos/Kconfig.shield
```kconfig
config SHIELD_SPACEMOS_DONGLE
  def_bool $(shields_list_contains,spacemos_dongle)

config SHIELD_SPACEMOS_LEFT
  def_bool $(shields_list_contains,spacemos_left)

config SHIELD_SPACEMOS_RIGHT
  def_bool $(shields_list_contains,spacemos_right)
```

## boards/shields/spacetyl/Kconfig.defconfig
```kconfig
if SHIELD_spacetyl_DONGLE
    config ZMK_KEYBOARD_NAME
        default "spacetyl"

    config ZMK_SPLIT_ROLE_CENTRAL
        default y

    config ZMK_SPLIT_BLE_CENTRAL_PERIPHERALS
        default 2

    config ZMK_USB
        default y

    config BT_MAX_CONN
        default 7

    config BT_MAX_PAIRED
        default 7
endif

# if SHIELD_spacetyl_LEFT
#
#     config ZMK_KEYBOARD_NAME
#         default "spacetyl"
#
#     # config ZMK_SPLIT_ROLE_CENTRAL
#     #     default y
#
# endif # SHIELD_spacetyl_LEFT

if SHIELD_spacetyl_LEFT || SHIELD_spacetyl_RIGHT || SHIELD_spacetyl_DONGLE


    config ZMK_SPLIT
        default y

    config ZMK_BLE
        default y

endif # SHIELD_spacetyl_LEFT || SHIELD_spacetyl_RIGHT

config ZMK_BOARD_COMPAT
    default y
```

## config/boards/shields/cosmotyl/Kconfig.defconfig
```kconfig
if SHIELD_cosmotyl_DONGLE
    config ZMK_KEYBOARD_NAME
        default "cosmotyl"

    config ZMK_SPLIT_ROLE_CENTRAL
        default y

    config ZMK_SPLIT_BLE_CENTRAL_PERIPHERALS
        default 2

    config ZMK_USB
        default y

    config BT_MAX_CONN
        default 7

    config BT_MAX_PAIRED
        default 7
endif

# if SHIELD_cosmotyl_LEFT
#
#     config ZMK_KEYBOARD_NAME
#         default "cosmotyl"
#
#     # config ZMK_SPLIT_ROLE_CENTRAL
#     #     default y
#
# endif # SHIELD_cosmotyl_LEFT

if SHIELD_cosmotyl_LEFT || SHIELD_cosmotyl_RIGHT || SHIELD_cosmotyl_DONGLE

    config ZMK_SPLIT
        default y

    config ZMK_BLE
        default y

endif # SHIELD_cosmotyl_LEFT || SHIELD_cosmotyl_RIGHT
```

## config/west.yml
```yaml
manifest:
  remotes:
    - name: zmkfirmware
      url-base: https://github.com/zmkfirmware
    - name: urob
      url-base: https://github.com/urob
    - name: vzhny
      url-base: https://github.com/vzhny
    - name: rianadon
      url-base: https://github.com/rianadon

  projects:
    - name: zmk
      remote: zmkfirmware
      revision: 268b1b1e82150460f00fd701bcd08583d5c75d29
      # path: modules/firmware/zmk
      import: app/west.yml
    # - name: zmk
    #   remote: rianadon
    #   revision: 4fc05c26b8faa35081282d58abc84fb6bd1b52bd
    #   import: app/west.yml
    - name: zmk-unicode
      remote: urob
      revision: 5f458b6f1fd8ca83f4aba793c2a64916522507e9
      path: modules/zmk/unicode

    - name: zmk-auto-layer
      remote: urob
      revision: 62c201934711369d50a28df12e1d055d05cb6460
      path: modules/zmk/auto-layer

    - name: zmk-helpers
      remote: urob
      revision: 4c71f803db34f5b888a1d09ef699e8e58d03f393
      path: modules/zmk/helpers

    - name: zmk-leader-key
      remote: urob
      revision: 43029f6fb950dec382774e60c6bcc020a906c942
      path: modules/zmk/leader-key

    - name: cosmos-zmk-module
      remote: rianadon
      revision: d76327385ea269b1450888c574c05ccab22beee6
      path: modules/zmk/cosmos
      import: config/west.yml

    - name: zephyr
      remote: zmkfirmware
      revision: 10ba6d0cb38bc3d258775d27982f707599320085
      path: modules/zephyr
      clone-depth: 1
      import:
        name-allowlist:
          - cmsis
          - hal_nordic
          - hal_rpi_pico
          - hal_stm32
          - lvgl
          - mbedtls
          - tinycrypt

  self:
    path: config

# manifest:
#   remotes:
#     - name: zmkfirmware
#       url-base: https://github.com/zmkfirmware
#     - name: rianadon
#       url-base: https://github.com/rianadon
#     - name: urob
#       url-base: https://github.com/urob
#
#   projects:
#     - name: zmk
#       remote: rianadon
#       revision: 4fc05c26b8faa35081282d58abc84fb6bd1b52bd
#       import: app/west.yml
#
#     - name: zmk-unicode
#       remote: urob
#       revision: v0.3
#
#     - name: zmk-helpers
#       remote: urob
#       revision: v0.3
#
#     - name: zmk-leader-key
#       remote: urob
#       revision: v0.3
#
#   self:
#     path: config
```
