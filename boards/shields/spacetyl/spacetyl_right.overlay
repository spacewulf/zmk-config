#include "spacetyl.dtsi"

/ {
    bootloader_key: bootloader_key {
        compatible = "zmk,boot-magic-key";
        key-position = <38>;
        jump-to-bootloader;
    };
};

&default_transform {
    col-offset = <7>;
};
