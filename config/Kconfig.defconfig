## config/Kconfig.defconfig
```kconfig
if SHIELD_spacetyl_LEFT

config ZMK_KEYBOARD_NAME
    default "spacetyl"

config ZMK_SPLIT_ROLE_CENTRAL
    default y

endif # SHIELD_spacetyl_LEFT

if SHIELD_spacetyl_LEFT || SHIELD_spacetyl_RIGHT

config ZMK_SPLIT
    default y

endif # SHIELD_spacetyl_LEFT || SHIELD_spacetyl_RIGHT
```

## config/Kconfig.shield
```kconfig
config SHIELD_spacetyl_LEFT
    def_bool $(shields_list_contains,spacetyl_left)

config SHIELD_spacetyl_RIGHT
    def_bool $(shields_list_contains,spacetyl_right)
```
