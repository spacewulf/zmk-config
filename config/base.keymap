// clang-format off
#include <behaviors.dtsi>
#include <behaviors/num_word.dtsi>
#include <behaviors/unicode.dtsi>
#include <zmk-helpers/helper.h>
#include <dt-bindings/zmk/bt.h>
#include <dt-bindings/zmk/outputs.h>
#include <dt-bindings/zmk/keys.h>

#include "num-word.dtsi"

#define _BT_SEL_KEYS_                                                           \
              &bt BT_SEL 0 &bt BT_SEL 1 &bt BT_SEL 2 &bt BT_SEL 3 &bt BT_CLR

#define QUICK_TAP_MS 175

#define BASE 0
#define NAV 1
#define NUM 2
#define FN 3
#define SYS 4
#define MOUSE 5
#define GAMING 6

#define XXX &none
#define ___ &trans

&sl {
  ignore-modifiers;
};

&lt {
  flavor = "balanced";
  tapping-term-ms = <200>;
  quick-tap-ms = <QUICK_TAP_MS>;
};

#define MAKE_HRM(NAME, HOLD, TAP, TRIGGER_POS)                          \
  ZMK_HOLD_TAP(NAME, bindings = <HOLD>, <TAP>; flavor = "balanced";     \
                tapping-term-ms = <280>; quick-tap-ms = <QUICK_TAP_MS>; \
                require-prior-idle-ms = <150>; hold-trigger-on-release; \
                hold-trigger-key-positions = <TRIGGER_POS>;)

MAKE_HRM(hml, &kp, &kp, KEYS_R THUMBS) // Left-hand HRMs.
MAKE_HRM(hmr, &kp, &kp, KEYS_L THUMBS) // Right-hand HRMs.

#define SMART_NUM &smart_num NUM 0
ZMK_HOLD_TAP(smart_num, bindings = <&mo>, <&num_dance>; flavor = "balanced"; tapping-term-ms = <250>; quick-tap-ms = <QUICK_TAP_MS>;)
ZMK_TAP_DANCE(num_dance, bindings = <&num_word NUM>, <&excel_word NUM>; tapping-term-ms = <250>;)


ZMK_TRI_STATE(swapper, bindings = <&kt LALT>, <&kp TAB>, <&kt LALT>;
              ignored-key-positions = <LT2 RT2 RM1 RM2 RM3>;)

ZMK_TRI_STATE(
              smart_mouse, bindings = <&tog MOUSE>, <&none>, <&tog MOUSE>;
              ignored-key-positions =
                <LT1 LT2 RT1 RT2 RT3 RM0 RM1 RM2 RM3 RM4 RB1 RB2 RB3 RH0 RH1>;
              ignored-layers = <MOUSE NAV FN>;)

#define SMART_FN &smart_fn FN 0
ZMK_HOLD_TAP(smart_fn, bindings = <&mo>, <&fn_dance>; flavor = "balanced"; tapping-term-ms = <250>; quick-tap-ms = <QUICK_TAP_MS>;)
ZMK_TAP_DANCE(fn_dance, bindings = <&sl FN>, <&tog FN>; tapping-term-ms = <250>;)

#define SMART_SYS &smart_sys NAV 0
ZMK_HOLD_TAP(smart_sys, bindings = <&mo>, <&sys_dance>; flavor = "balanced"; tapping-term-ms = <250>; quick-tap-ms = <QUICK_TAP_MS>;)
ZMK_TAP_DANCE(sys_dance, bindings = <&sl SYS>, <&tog SYS>; tapping-term-ms = <250>;)

#define SMART_DEL &smart_del LC(DEL) DEL
ZMK_HOLD_TAP(smart_del, bindings = <&kp>, <&kp>; flavor = "balanced"; tapping-term-ms = <250>; quick-tap-ms = <QUICK_TAP_MS>;)

#define SMART_BSPC &smart_bspc LC(BSPC) BSPC
ZMK_HOLD_TAP(smart_bspc, bindings = <&kp>, <&kp>; flavor = "balanced"; tapping-term-ms = <250>; quick-tap-ms = <QUICK_TAP_MS>;)

#define CR_DANCE &cr_dance
ZMK_TAP_DANCE(cr_dance, bindings = <&kp RETURN>, <&kp LG(RETURN)>; tapping-term-ms = <150>;)

#define LMOD_DANCE &lmod_dance
#define RMOD_DANCE &rmod_dance
ZMK_TAP_DANCE(lmod_dance, bindings = <&kp LGUI>, <&kp LG(SPACE)>; tapping-term-ms = <250>;)
ZMK_TAP_DANCE(rmod_dance, bindings = <&kp RGUI>, <&kp RG(SPACE)>; tapping-term-ms = <250>;)

#define SIMPLE_MORPH(NAME, MOD, BINDING1, BINDING2)                            \
  ZMK_MOD_MORPH(NAME, mods = <(MOD_L##MOD | MOD_R##MOD)>;                      \
                bindings = <BINDING1>, <BINDING2>;)

// Tap: comman | Shift + tap: semicolon | Ctrl + Shift  + tap: <.
SIMPLE_MORPH(comma_morph, SFT, &kp COMMA, &comma_inner_morph)
SIMPLE_MORPH(comma_inner_morph, CTL, &kp SEMICOLON, &kp LESS_THAN)

// Tap: dot | Shift + tap: colon | Ctrl + Shift  + tap: >.
SIMPLE_MORPH(dot_morph, SFT, &kp DOT, &dot_inner_morph)
SIMPLE_MORPH(dot_inner_morph, CTL, &kp COLON, &kp GREATER_THAN)

// Tap: left/right parenthesis | Shift + tap: less-than/greater-than.
SIMPLE_MORPH(lpar_lt, SFT, &kp LPAR, &kp LT)
SIMPLE_MORPH(rpar_gt, SFT, &kp RPAR, &kp GT)

// Hack: Make HRM combos tap-only (cf, ZMK issue #544).
#define ZMK_COMBO_8(NAME, TAP, POS, LAYERS, COMBO_MS, IDLE_MS, HOLD, SIDE)     \
  MAKE_HRM(hm_combo_##NAME, &kp, TAP, SIDE THUMBS)                             \
  ZMK_COMBO_6(NAME, &hm_combo_##NAME HOLD 0, POS, LAYERS, COMBO_MS, IDLE_MS)

#include "combos.dtsi"
#include "leader.dtsi"
#include "mouse.dtsi"
#include "tap-dance.dtsi"

#define VOL_UP &kp C_VOLUME_UP
#define VOL_DN &kp C_VOLUME_DOWN
#define NUM_LK &kp KP_NUMLOCK
#define NP_MUL &kp KP_MULTIPLY
#define NP_DIV &kp KP_DIVIDE
#define NP_ADD &kp KP_PLUS
#define NP_SUB &kp KP_SUBTRACT
#define NP_ENT &kp KP_ENTER
#define NP_EQU &kp KP_EQUAL

#ifndef ZMK_BASE_LAYER
    #define ZMK_BASE_LAYER(name, LN, RN, LT, RT, LM, RM, LB, RB, LF, RF, LHT, RHT, LHB, RHB)    \
        ZMK_LAYER(name, LN RN LT RT LM RM LB RB LF RF LHT RHT LHB RHB)
#endif

ZMK_BASE_LAYER(Base,
//╭─────────────┬─────────────┬─────────────┬─────────────┬─────────────┬─────────────╮ ╭─────────────┬─────────────┬─────────────┬─────────────┬─────────────┬─────────────╮
    &kp ESC         &kp N1        &kp N2        &kp N3        &kp N4       &kp N5     ,    &kp N6         &kp N7        &kp N8        &kp N9        &kp N0        &kp GRAVE ,
//├─────────────┼─────────────┼─────────────┼─────────────┼─────────────┼─────────────┤ ├─────────────┼─────────────┼─────────────┼─────────────┼─────────────┼─────────────┤
    &kp TAB         &kp Q         &kp W         &kp E         &kp R        &kp T      ,    &kp Y          &kp U         &kp I         &kp O         &kp P         &kp BSLH  ,
//├─────────────┼─────────────┼─────────────┼─────────────┼─────────────┼─────────────┤ ├─────────────┼─────────────┼─────────────┼─────────────┼─────────────┼─────────────┤
    &kp LSHFT     &hml LGUI A   &hml LALT S   &hml LSHFT D  &hml LCTRL F   &kp G      ,    &kp H        &hmr LCTRL J  &hmr RSHFT K  &hmr LALT L  &hmr LGUI SEMI   &kp SQT   ,
//├─────────────┼─────────────┼─────────────┼─────────────┼─────────────┼─────────────┤ ├─────────────┼─────────────┼─────────────┼─────────────┼─────────────┼─────────────┤
    &kp LCTRL       &kp Z         &kp X         &kp C         &kp V        &kp B      ,    &kp N          &kp M       &comma_morph   &dot_morph     &kp FSLH      &kp RSHFT ,
//╰─────────────┴─────────────┼─────────────┼─────────────┼─────────────┴─────────────╯ ╰─────────────┴─────────────┼─────────────┼─────────────┼─────────────┴─────────────╯
                                  &kp LBKT      &kp RBKT                              ,                                &kp MINUS     &kp EQUAL  ,
//                            ╰─────────────┴─────────────╯                                                         ╰─────────────┴─────────────╯
//                                          ╭─────────────┬─────────────┬─────────────╮ ╭─────────────┬─────────────┬─────────────╮
                                               SMART_SYS     &kp SPACE     &kp DEL    ,    &kp BSPC      &kp RETURN    SMART_NUM  ,
//                                          ╰─────────────┼─────────────┼─────────────┤ ├─────────────┼─────────────┼─────────────╯
                                                             &kp ESC       &kp LGUI   ,    &kp RGUI       &kp ESC
//                                                        ╰─────────────┴─────────────╯ ╰─────────────┴─────────────╯
)

ZMK_BASE_LAYER(Nav,
//╭─────────────┬─────────────┬─────────────┬─────────────┬─────────────┬─────────────╮ ╭─────────────┬─────────────┬─────────────┬─────────────┬─────────────┬─────────────╮
    &kp F12         &kp F1        &kp F2        &kp F3        &kp F4       &kp F5     ,    &kp F6         &kp F7        &kp F8        &kp F9        &kp F10       &kp F11   ,
//├─────────────┼─────────────┼─────────────┼─────────────┼─────────────┼─────────────┤ ├─────────────┼─────────────┼─────────────┼─────────────┼─────────────┼─────────────┤
        ___           ___        &kp C_PREV    &kp C_PP      &kp C_NEXT     VOL_UP    ,       ___           ___           ___           ___           ___           ___     ,
//├─────────────┼─────────────┼─────────────┼─────────────┼─────────────┼─────────────┤ ├─────────────┼─────────────┼─────────────┼─────────────┼─────────────┼─────────────┤
    &bootloader       ___           ___           ___           ___         VOL_DN    ,    &kp LEFT       &kp DOWN      &kp UP        &kp RIGHT       ___           ___     ,
//├─────────────┼─────────────┼─────────────┼─────────────┼─────────────┼─────────────┤ ├─────────────┼─────────────┼─────────────┼─────────────┼─────────────┼─────────────┤
        ___           ___           ___           ___           ___           ___     ,       ___           ___           ___           ___           ___           ___     ,
//╰─────────────┴─────────────┼─────────────┼─────────────┼─────────────┴─────────────╯ ╰─────────────┴─────────────┼─────────────┼─────────────┼─────────────┴─────────────╯
                                    ___           ___                                 ,                                   ___           ___     ,
//                            ╰─────────────┴─────────────╯                                                         ╰─────────────┴─────────────╯
//                                          ╭─────────────┬─────────────┬─────────────╮ ╭─────────────┬─────────────┬─────────────╮
                                                  &mo 1      &kp SPACE     &kp DEL    ,    &kp BSPC      &kp RETURN      &mo 2    ,
//                                          ╰─────────────┼─────────────┼─────────────┤ ├─────────────┼─────────────┼─────────────╯
                                                             &bootloader   &kp LGUI   ,    &kp RGUI     &bootloader
//                                                        ╰─────────────┴─────────────╯ ╰─────────────┴─────────────╯
)

ZMK_BASE_LAYER(Num,
//╭─────────────┬─────────────┬─────────────┬─────────────┬─────────────┬─────────────╮ ╭─────────────┬─────────────┬─────────────┬─────────────┬─────────────┬─────────────╮
        ___           ___           ___           ___           ___           ___     ,       ___          NUM_LK        NP_DIV        NP_MUL        NP_SUB         ___     ,
//├─────────────┼─────────────┼─────────────┼─────────────┼─────────────┼─────────────┤ ├─────────────┼─────────────┼─────────────┼─────────────┼─────────────┼─────────────┤
        ___           ___           ___           ___           ___           ___     ,       ___          &kp N7        &kp N8        &kp N9        NP_ADD         ___     ,
//├─────────────┼─────────────┼─────────────┼─────────────┼─────────────┼─────────────┤ ├─────────────┼─────────────┼─────────────┼─────────────┼─────────────┼─────────────┤
        ___           ___           ___           ___           ___           ___     ,       ___          &kp N4        &kp N5        &kp N6        NP_ENT     &bootloader ,
//├─────────────┼─────────────┼─────────────┼─────────────┼─────────────┼─────────────┤ ├─────────────┼─────────────┼─────────────┼─────────────┼─────────────┼─────────────┤
        ___           ___           ___           ___           ___           ___     ,     NUM_LK         &kp N1        &kp N2        &kp N3        NP_EQU         ___     ,
//╰─────────────┴─────────────┼─────────────┼─────────────┼─────────────┴─────────────╯ ╰─────────────┴─────────────┼─────────────┼─────────────┼─────────────┴─────────────╯
                                    ___           ___                                 ,                                  &kp N0        &kp DOT  ,
//                            ╰─────────────┴─────────────╯                                                         ╰─────────────┴─────────────╯
//                                          ╭─────────────┬─────────────┬─────────────╮ ╭─────────────┬─────────────┬─────────────╮
                                                  ___           ___           ___     ,       ___           ___           ___     ,
//                                          ╰─────────────┼─────────────┼─────────────┤ ├─────────────┼─────────────┼─────────────╯
                                                                ___           ___     ,       ___           ___
//                                                        ╰─────────────┴─────────────╯ ╰─────────────┴─────────────╯
)

ZMK_BASE_LAYER(Fn,
//╭─────────────┬─────────────┬─────────────┬─────────────┬─────────────┬─────────────╮ ╭─────────────┬─────────────┬─────────────┬─────────────┬─────────────┬─────────────╮
        ___           ___           ___           ___           ___           ___     ,       ___           ___           ___           ___           ___           ___     ,
//├─────────────┼─────────────┼─────────────┼─────────────┼─────────────┼─────────────┤ ├─────────────┼─────────────┼─────────────┼─────────────┼─────────────┼─────────────┤
        ___          &kp F12       &kp F7        &kp F8        &kp F9       &kp LALT  ,       ___           ___           ___           ___           ___           ___     ,
//├─────────────┼─────────────┼─────────────┼─────────────┼─────────────┼─────────────┤ ├─────────────┼─────────────┼─────────────┼─────────────┼─────────────┼─────────────┤
        ___          &kp F11       &kp F4        &kp F5        &kp F6       &kp LSHFT ,       ___           ___           ___           ___           ___           ___     ,
//├─────────────┼─────────────┼─────────────┼─────────────┼─────────────┼─────────────┤ ├─────────────┼─────────────┼─────────────┼─────────────┼─────────────┼─────────────┤
        ___          &kp F10       &kp F1        &kp F2        &kp F3       &kp LCTRL ,       ___           ___           ___           ___           ___           ___     ,
//╰─────────────┴─────────────┼─────────────┼─────────────┼─────────────┴─────────────╯ ╰─────────────┴─────────────┼─────────────┼─────────────┼─────────────┴─────────────╯
                                    ___           ___                                 ,                                   ___           ___     ,
//                            ╰─────────────┴─────────────╯                                                         ╰─────────────┴─────────────╯
//                                          ╭─────────────┬─────────────┬─────────────╮ ╭─────────────┬─────────────┬─────────────╮
                                                  ___           ___           ___     ,       ___           ___           ___     ,
//                                          ╰─────────────┼─────────────┼─────────────┤ ├─────────────┼─────────────┼─────────────╯
                                                                ___           ___     ,       ___           ___
//                                                        ╰─────────────┴─────────────╯ ╰─────────────┴─────────────╯
)

ZMK_BASE_LAYER(Sys,
//╭─────────────┬─────────────┬─────────────┬─────────────┬─────────────┬─────────────╮ ╭─────────────┬─────────────┬─────────────┬─────────────┬─────────────┬─────────────╮
                                      _BT_SEL_KEYS_                                   ,       ___           ___           ___           ___           ___           ___     ,
//├─────────────┼─────────────┼─────────────┼─────────────┼─────────────┼─────────────┤ ├─────────────┼─────────────┼─────────────┼─────────────┼─────────────┼─────────────┤
        ___           ___        &kp C_PREV    &kp C_PP     &kp C_NEXT      VOL_UP    ,   &kp C_BRI_UP      ___           ___           ___           ___           ___     ,
//├─────────────┼─────────────┼─────────────┼─────────────┼─────────────┼─────────────┤ ├─────────────┼─────────────┼─────────────┼─────────────┼─────────────┼─────────────┤
        ___           ___           ___           ___           ___         VOL_DN    ,   &kp C_BRI_DN      ___           ___           ___           ___           ___     ,
//├─────────────┼─────────────┼─────────────┼─────────────┼─────────────┼─────────────┤ ├─────────────┼─────────────┼─────────────┼─────────────┼─────────────┼─────────────┤
        ___           ___           ___           ___           ___        &kp C_MUTE ,       ___           ___           ___           ___           ___           ___     ,
//╰─────────────┴─────────────┼─────────────┼─────────────┼─────────────┴─────────────╯ ╰─────────────┴─────────────┼─────────────┼─────────────┼─────────────┴─────────────╯
                                    ___           ___                                 ,                                   ___           ___     ,
//                            ╰─────────────┴─────────────╯                                                         ╰─────────────┴─────────────╯
//                                          ╭─────────────┬─────────────┬─────────────╮ ╭─────────────┬─────────────┬─────────────╮
                                                  ___           ___           ___     ,       ___           ___           ___     ,
//                                          ╰─────────────┼─────────────┼─────────────┤ ├─────────────┼─────────────┼─────────────╯
                                                                ___           ___     ,       ___           ___
//                                                        ╰─────────────┴─────────────╯ ╰─────────────┴─────────────╯
)

ZMK_BASE_LAYER(Mouse,
//╭─────────────┬─────────────┬─────────────┬─────────────┬─────────────┬─────────────╮ ╭─────────────┬─────────────┬─────────────┬─────────────┬─────────────┬─────────────╮
        ___           ___           ___           ___           ___           ___     ,       ___           ___           ___           ___           ___           ___     ,
//├─────────────┼─────────────┼─────────────┼─────────────┼─────────────┼─────────────┤ ├─────────────┼─────────────┼─────────────┼─────────────┼─────────────┼─────────────┤
        ___           ___           ___           ___           ___           ___     ,       ___        &kp PG_UP      U_MS_U       &kp PG_DN        ___           ___     ,
//├─────────────┼─────────────┼─────────────┼─────────────┼─────────────┼─────────────┤ ├─────────────┼─────────────┼─────────────┼─────────────┼─────────────┼─────────────┤
        ___           ___           ___           ___           ___           ___     ,      U_WH_L        U_MS_L       U_MS_D         U_MS_R        U_WH_R         ___     ,
//├─────────────┼─────────────┼─────────────┼─────────────┼─────────────┼─────────────┤ ├─────────────┼─────────────┼─────────────┼─────────────┼─────────────┼─────────────┤
        ___           ___           ___           ___           ___           ___     ,       ___        &mkp LCLK     &mkp MCLK     &mkp RCLK        ___           ___     ,
//╰─────────────┴─────────────┼─────────────┼─────────────┼─────────────┴─────────────╯ ╰─────────────┴─────────────┼─────────────┼─────────────┼─────────────┴─────────────╯
                                    ___           ___                                 ,                                   ___           ___     ,
//                            ╰─────────────┴─────────────╯                                                         ╰─────────────┴─────────────╯
//                                          ╭─────────────┬─────────────┬─────────────╮ ╭─────────────┬─────────────┬─────────────╮
                                                  ___           ___           ___     ,       ___          U_WH_U        U_WH_D   ,
//                                          ╰─────────────┼─────────────┼─────────────┤ ├─────────────┼─────────────┼─────────────╯
                                                                ___           ___     ,       ___           ___
//                                                        ╰─────────────┴─────────────╯ ╰─────────────┴─────────────╯
)

ZMK_BASE_LAYER(Gaming,
//╭─────────────┬─────────────┬─────────────┬─────────────┬─────────────┬─────────────╮ ╭─────────────┬─────────────┬─────────────┬─────────────┬─────────────┬─────────────╮
        ___           ___           ___           ___           ___           ___     ,       ___           ___           ___           ___           ___       &tog GAMING ,
//├─────────────┼─────────────┼─────────────┼─────────────┼─────────────┼─────────────┤ ├─────────────┼─────────────┼─────────────┼─────────────┼─────────────┼─────────────┤
        ___           ___           ___           ___           ___           ___     ,       ___           ___           ___           ___           ___           ___     ,
//├─────────────┼─────────────┼─────────────┼─────────────┼─────────────┼─────────────┤ ├─────────────┼─────────────┼─────────────┼─────────────┼─────────────┼─────────────┤
        ___          &kp A         &kp S         &kp D         &kp F          ___     ,       ___          &kp J         &kp K         &kp L         &kp SEMI       ___     ,
//├─────────────┼─────────────┼─────────────┼─────────────┼─────────────┼─────────────┤ ├─────────────┼─────────────┼─────────────┼─────────────┼─────────────┼─────────────┤
        ___           ___           ___           ___           ___           ___     ,       ___           ___           ___           ___           ___           ___     ,
//╰─────────────┴─────────────┼─────────────┼─────────────┼─────────────┴─────────────╯ ╰─────────────┴─────────────┼─────────────┼─────────────┼─────────────┴─────────────╯
                                    ___           ___                                 ,                                   ___           ___     ,
//                            ╰─────────────┴─────────────╯                                                         ╰─────────────┴─────────────╯
//                                          ╭─────────────┬─────────────┬─────────────╮ ╭─────────────┬─────────────┬─────────────╮
                                                  ___           ___           ___     ,       ___           ___           ___     ,
//                                          ╰─────────────┼─────────────┼─────────────┤ ├─────────────┼─────────────┼─────────────╯
                                                              &kp LALT        ___     ,       ___           ___
//                                                        ╰─────────────┴─────────────╯ ╰─────────────┴─────────────╯
)


//╭─────────────┬─────────────┬─────────────┬─────────────┬─────────────┬─────────────╮ ╭─────────────┬─────────────┬─────────────┬─────────────┬─────────────┬─────────────╮
        // ___           ___           ___           ___           ___           ___     ,       ___           ___           ___           ___           ___           ___     ,
//├─────────────┼─────────────┼─────────────┼─────────────┼─────────────┼─────────────┤ ├─────────────┼─────────────┼─────────────┼─────────────┼─────────────┼─────────────┤
        // ___           ___           ___           ___           ___           ___     ,       ___           ___           ___           ___           ___           ___     ,
//├─────────────┼─────────────┼─────────────┼─────────────┼─────────────┼─────────────┤ ├─────────────┼─────────────┼─────────────┼─────────────┼─────────────┼─────────────┤
        // ___           ___           ___           ___           ___           ___     ,       ___           ___           ___           ___           ___           ___     ,
//├─────────────┼─────────────┼─────────────┼─────────────┼─────────────┼─────────────┤ ├─────────────┼─────────────┼─────────────┼─────────────┼─────────────┼─────────────┤
        // ___           ___           ___           ___           ___           ___     ,       ___           ___           ___           ___           ___           ___     ,
//╰─────────────┴─────────────┼─────────────┼─────────────┼─────────────┴─────────────╯ ╰─────────────┴─────────────┼─────────────┼─────────────┼─────────────┴─────────────╯
                                    // ___           ___                                 ,                                   ___           ___     ,
//                            ╰─────────────┴─────────────╯                                                         ╰─────────────┴─────────────╯
//                                          ╭─────────────┬─────────────┬─────────────╮ ╭─────────────┬─────────────┬─────────────╮
                                                  // ___           ___           ___     ,       ___           ___           ___     ,
//                                          ╰─────────────┼─────────────┼─────────────┤ ├─────────────┼─────────────┼─────────────╯
                                                                // ___           ___     ,       ___           ___
//                                                        ╰─────────────┴─────────────╯ ╰─────────────┴─────────────╯

// clang-format on

/* vim: set ft=c tw=146: */
