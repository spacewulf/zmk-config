// clang-format off
#include <behaviors.dtsi>
#include <behaviors/num_word.dtsi>
#include <behaviors/unicode.dtsi>
#include <zmk-helpers/helper.h>
#include <dt-bindings/zmk/bt.h>
#include <dt-bindings/zmk/keys.h>
#include <dt-bindings/zmk/rgb.h>
#include <zmk-helpers/helper.h>

#include "cosmotyl68.h"
#include "num-word.dtsi"

#define QUICK_TAP_MS 175

#define BASE 0
#define NAV 1
#define NUM 2
#define SYS 3

#define XXX &none
#define ___ &trans

&sl {
    ignore-modifiers;
};

&lt {
    flavor = "balanced";
    tapping-term-ms = <200>;
    quick-tap-ms = <QUICK_TAP_MS>;
};

#define MAKE_HRM(NAME, HOLD, TAP, TRIGGER_POS)                                 \
  ZMK_HOLD_TAP(NAME, bindings = <HOLD>, <TAP>; flavor = "balanced";            \
               tapping-term-ms = <280>; quick-tap-ms = <QUICK_TAP_MS>;         \
               require-prior-idle-ms = <150>; hold-trigger-on-release;         \
               hold-trigger-key-positions = <TRIGGER_POS>;)

MAKE_HRM(hml, &kp, &kp, KEYS_R THUMBS) // Left-hand HRMs.
MAKE_HRM(hmr, &kp, &kp, KEYS_L THUMBS) // Right-hand HRMs.


#define SMART_NUM &smart_num NUM 0
ZMK_HOLD_TAP(smart_num, bindings = <&mo>, <&num_dance>; flavor = "balanced"; tapping-term-ms = <250>; quick-tap-ms = <QUICK_TAP_MS>;)
ZMK_TAP_DANCE(num_dance, bindings = <&num_word NUM>, <&excel_word NUM>; tapping-term-ms = <250>;)

#define SMART_SYS &smart_sys NAV 0
ZMK_HOLD_TAP(smart_sys, bindings = <&mo>, <&sys_dance>; flavor = "balanced"; tapping-term-ms = <250>; quick-tap-ms = <QUICK_TAP_MS>;)

ZMK_TAP_DANCE(sys_dance, bindings = <&sl SYS>, <&tog SYS>; tapping-term-ms = <250>;)

#define SIMPLE_MORPH(NAME, MOD, BINDING1, BINDING2)                            \
  ZMK_MOD_MORPH(NAME, mods = <(MOD_L##MOD | MOD_R##MOD)>;                      \
                bindings = <BINDING1>, <BINDING2>;)

// Tap: comman | Shift + tap: semicolon | Ctrl + Shift  + tap: <.
SIMPLE_MORPH(comma_morph, SFT, &kp COMMA, &comma_inner_morph)
SIMPLE_MORPH(comma_inner_morph, CTL, &kp SEMICOLON, &kp LESS_THAN)

// Tap: dot | Shift + tap: colon | Ctrl + Shift  + tap: >.
SIMPLE_MORPH(dot_morph, SFT, &kp DOT, &dot_inner_morph)
SIMPLE_MORPH(dot_inner_morph, CTL, &kp COLON, &kp GREATER_THAN)

// Hack: Make HRM combos tap-only (cf, ZMK issue #544).
#define ZMK_COMBO_8(NAME, TAP, POS, LAYERS, COMBO_MS, IDLE_MS, HOLD, SIDE)     \
  MAKE_HRM(hm_combo_##NAME, &kp, TAP, SIDE THUMBS)                             \
  ZMK_COMBO_6(NAME, &hm_combo_##NAME HOLD 0, POS, LAYERS, COMBO_MS, IDLE_MS)

#include "combos.dtsi"
#include "leader.dtsi"
/* #include "mouse.dtsi" */
#include "tap-dance.dtsi"

#define RGB_UP &rgb_ug RGB_BRI
#define RGB_DN &rgb_ug RGB_BRD
#define RGB_WT &rgb_ug RGB_COLOR_HSB(200, 0, 100)
#define RGB_TG &rgb_ug RGB_TOG
#define VOL_UP &kp C_VOLUME_UP
#define VOL_DN &kp C_VOLUME_DOWN
#define NUM_LK &kp KP_NUMLOCK
#define STD_UL &studio_unlock

#ifndef ZMK_BASE_LAYER
    #define ZMK_BASE_LAYER(name, LN, RN, LT, RT, LM, RM, LB, RB, LF, RF, LHT, RHT, LHM, RHM, LHB, RHB)    \
        ZMK_LAYER(name, LN RN LT RT LM RM LB RB LF RF LHT RHT LHM RHM LHB RHB)
#endif

ZMK_BASE_LAYER(Base,
//╭─────────────┬─────────────┬─────────────┬─────────────┬─────────────┬─────────────╮ ╭─────────────┬─────────────┬─────────────┬─────────────┬─────────────┬─────────────╮
    &kp ESC         &kp N1        &kp N2        &kp N3        &kp N4       &kp N5     ,    &kp N6         &kp N7        &kp N8        &kp N9        &kp N0        &kp GRAVE ,
//├─────────────┼─────────────┼─────────────┼─────────────┼─────────────┼─────────────┤ ├─────────────┼─────────────┼─────────────┼─────────────┼─────────────┼─────────────┤
    &kp TAB         &kp Q         &kp W         &kp E         &kp R        &kp T      ,    &kp Y          &kp U         &kp I         &kp O         &kp P         &kp BSLH  ,
//├─────────────┼─────────────┼─────────────┼─────────────┼─────────────┼─────────────┤ ├─────────────┼─────────────┼─────────────┼─────────────┼─────────────┼─────────────┤
    &caps_word      &kp A         &kp S         &kp D         &kp F        &kp G      ,    &kp H          &kp J         &kp K         &kp L         &kp SEMI      &kp SQT   ,
//├─────────────┼─────────────┼─────────────┼─────────────┼─────────────┼─────────────┤ ├─────────────┼─────────────┼─────────────┼─────────────┼─────────────┼─────────────┤
    &kp LSHFT       &kp Z         &kp X         &kp C         &kp V        &kp B      ,    &kp N          &kp M       &comma_morph   &dot_morph     &kp FSLH      &kp RSHFT ,
//├─────────────┼─────────────┼─────────────┼─────────────┼─────────────┴─────────────╯ ╰─────────────┴─────────────┼─────────────┼─────────────┼─────────────┼─────────────┤
    &kp LCTRL       &kp LALT      &kp LBKT      &kp RBKT  ,                                                             &kp MINUS     &kp EQUAL     &kp RALT      &kp RCTRL ,
//╰─────────────┴─────────────┴─────────────┴─────────────╯                                                         ╰─────────────┴─────────────┴─────────────┴─────────────╯

//                                                        ╭─────────────┬─────────────╮ ╭─────────────┬─────────────╮
                                                             SMART_SYS     &kp SPACE  ,    &kp RETURN    SMART_NUM  ,
//                                                        ├─────────────┼─────────────┤ ├─────────────┼─────────────┤
                                                              &kp LALT     &kp DEL    ,    &kp BSPC       &kp ESC   ,
//                                                        ├─────────────┼─────────────┤ ├─────────────┼─────────────┤
                                                              &kp LGUI     &kp LCTRL  ,    &kp RCTRL      &kp RGUI
//                                                        ╰─────────────┴─────────────╯ ╰─────────────┴─────────────╯
)

ZMK_BASE_LAYER(Nav,
//╭─────────────┬─────────────┬─────────────┬─────────────┬─────────────┬─────────────╮ ╭─────────────┬─────────────┬─────────────┬─────────────┬─────────────┬─────────────╮
    &kp F12         &kp F1        &kp F2        &kp F3        &kp F4       &kp F5     ,    &kp F6         &kp F7        &kp F8        &kp F9        &kp F10      &kp F11    ,
//├─────────────┼─────────────┼─────────────┼─────────────┼─────────────┼─────────────┤ ├─────────────┼─────────────┼─────────────┼─────────────┼─────────────┼─────────────┤
        ___           ___        &kp C_PREV     &kp C_PP      &kp C_NEXT   VOL_UP     ,     ___            ___            ___          ___            ___          ___      ,
//├─────────────┼─────────────┼─────────────┼─────────────┼─────────────┼─────────────┤ ├─────────────┼─────────────┼─────────────┼─────────────┼─────────────┼─────────────┤
    &bootloader     &kp LEFT      &kp UP        &kp DOWN      &kp RIGHT    VOL_DN     ,    &kp LEFT       &kp DOWN       &kp UP      &kp RIGHT        ___          ___      ,
//├─────────────┼─────────────┼─────────────┼─────────────┼─────────────┼─────────────┤ ├─────────────┼─────────────┼─────────────┼─────────────┼─────────────┼─────────────┤
    &kp LSHFT       &kp Z         &kp X         &kp C         &kp V        &kp B      ,    &kp N          &kp M       &comma_morph   &dot_morph     &kp FSLH     &kp RSHFT  ,
//├─────────────┼─────────────┼─────────────┼─────────────┼─────────────┴─────────────╯ ╰─────────────┴─────────────┼─────────────┼─────────────┼─────────────┼─────────────┤
        ___           ___           ___           ___                                 ,                                   ___          ___            ___          ___      ,
//╰─────────────┴─────────────┴─────────────┴─────────────╯                                                         ╰─────────────┴─────────────┴─────────────┴─────────────╯

//                                                        ╭─────────────┬─────────────╮ ╭─────────────┬─────────────╮
                                                              &mo 1        &kp SPACE  ,    &kp RETURN     &mo 2     ,
//                                                        ├─────────────┼─────────────┤ ├─────────────┼─────────────┤
                                                              &kp LALT     &kp DEL    ,    &kp BSPC       &kp ESC   ,
//                                                        ├─────────────┼─────────────┤ ├─────────────┼─────────────┤
                                                              &kp LGUI     &kp LCTRL  ,    &kp RCTRL      &kp RGUI
//                                                        ╰─────────────┴─────────────╯ ╰─────────────┴─────────────╯
)

ZMK_BASE_LAYER(Num,
//╭─────────────┬─────────────┬─────────────┬─────────────┬─────────────┬─────────────╮ ╭─────────────┬─────────────┬─────────────┬─────────────┬─────────────┬─────────────╮
        ___          RGB_TG        RGB_WT       RGB_DN         RGB_UP        ___      ,     ___            ___            ___          ___            ___          ___      ,
//├─────────────┼─────────────┼─────────────┼─────────────┼─────────────┼─────────────┤ ├─────────────┼─────────────┼─────────────┼─────────────┼─────────────┼─────────────┤
        ___           ___           ___          ___           ___         ___        ,     ___            &kp N7         &kp N8       &kp N9         ___          ___      ,
//├─────────────┼─────────────┼─────────────┼─────────────┼─────────────┼─────────────┤ ├─────────────┼─────────────┼─────────────┼─────────────┼─────────────┼─────────────┤
        ___           ___           ___          ___           ___         ___        ,     ___            &kp N4         &kp N5       &kp N6         ___       &bootloader ,
//├─────────────┼─────────────┼─────────────┼─────────────┼─────────────┼─────────────┤ ├─────────────┼─────────────┼─────────────┼─────────────┼─────────────┼─────────────┤
        ___           ___           ___          ___           ___         ___        ,     NUM_LK         &kp N1         &kp N2       &kp N3         ___          ___      ,
//├─────────────┼─────────────┼─────────────┼─────────────┼─────────────┴─────────────╯ ╰─────────────┴─────────────┼─────────────┼─────────────┼─────────────┼─────────────┤
        ___           ___           ___           ___                                 ,                                   &kp N0       &kp DOT        ___          ___      ,
//╰─────────────┴─────────────┴─────────────┴─────────────╯                                                         ╰─────────────┴─────────────┴─────────────┴─────────────╯

//                                                        ╭─────────────┬─────────────╮ ╭─────────────┬─────────────╮
                                                               STD_UL      &kp SPACE  ,    &kp RETURN     &mo 2     ,
//                                                        ├─────────────┼─────────────┤ ├─────────────┼─────────────┤
                                                              &kp LALT     &kp DEL    ,    &kp BSPC       &kp ESC   ,
//                                                        ├─────────────┼─────────────┤ ├─────────────┼─────────────┤
                                                              &kp LGUI     &kp LCTRL  ,    &kp RCTRL      &kp RGUI
//                                                        ╰─────────────┴─────────────╯ ╰─────────────┴─────────────╯
)

ZMK_BASE_LAYER(Sys,
//╭─────────────┬─────────────┬─────────────┬─────────────┬─────────────┬─────────────╮ ╭─────────────┬─────────────┬─────────────┬─────────────┬─────────────┬─────────────╮
        ___           ___           ___           ___           ___        &kp C_MUTE ,       ___           ___           ___           ___           ___           ___     ,
//├─────────────┼─────────────┼─────────────┼─────────────┼─────────────┼─────────────┤ ├─────────────┼─────────────┼─────────────┼─────────────┼─────────────┼─────────────┤
        ___           ___        &kp C_PREV     &kp C_PP     &kp C_NEXT      VOL_UP   ,  &kp C_BRI_UP     RGB_UP          ___           ___           ___           ___     ,
//├─────────────┼─────────────┼─────────────┼─────────────┼─────────────┼─────────────┤ ├─────────────┼─────────────┼─────────────┼─────────────┼─────────────┼─────────────┤
        ___           ___           ___           ___           ___          VOL_DN   ,  &kp C_BRI_DN     RGB_DN          ___           ___           ___           ___     ,
//├─────────────┼─────────────┼─────────────┼─────────────┼─────────────┼─────────────┤ ├─────────────┼─────────────┼─────────────┼─────────────┼─────────────┼─────────────┤
        ___           ___           ___           ___           ___           ___     ,       ___           ___           ___           ___           ___           ___     ,
//├─────────────┼─────────────┼─────────────┼─────────────┼─────────────┴─────────────╯ ╰─────────────┴─────────────┼─────────────┼─────────────┼─────────────┼─────────────┤
        ___           ___           ___           ___                                 ,                                   ___           ___           ___           ___     ,
//╰─────────────┴─────────────┴─────────────┴─────────────╯                                                         ╰─────────────┴─────────────┴─────────────┴─────────────╯

//                                                        ╭─────────────┬─────────────╮ ╭─────────────┬─────────────╮
                                                             SMART_SYS     &kp SPACE  ,    &kp RETURN     &mo 2     ,
//                                                        ├─────────────┼─────────────┤ ├─────────────┼─────────────┤
                                                              &kp LALT     &kp DEL    ,    &kp BSPC       &kp ESC   ,
//                                                        ├─────────────┼─────────────┤ ├─────────────┼─────────────┤
                                                              &kp LGUI     &kp LCTRL  ,    &kp RCTRL      &kp RGUI
//                                                        ╰─────────────┴─────────────╯ ╰─────────────┴─────────────╯
)
// clang-format on

/* vim: set ft=c tw=146: */
